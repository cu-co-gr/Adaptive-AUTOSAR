AUTOSAR XML (schema 00050)
package /ExecutionManifest
  communication-cluster protocol-version=1:
    ethernet physical channel Localhost
      network endpoint RpcServerEP: network-endpoint-addresses=ipv-4-configuration=ipv-4-address=127.0.0.1
  ethernet communication connector RpcServerConn
    ap application endpoint ServerUnicastTcp: tp-configuration=tcp-tp=tcp-tp-port=port-number=18080
  function group MachineFG
    mode-declaration-group initial-mode=Off:
      mode Off
      mode StartUp
  processes:
    4 x process:
      StateManagement: executable-path=./build/bin/state_management, bootstrap=true
      PlatformHealthManagement: executable-path=./build/bin/platform_health_management, bootstrap=false, function-group-state{function-group=MachineFG, function-group-state=StartUp}
      ExtendedVehicle: executable-path=./build/bin/extended_vehicle, bootstrap=false, function-group-state{function-group=MachineFG, function-group-state=StartUp}
      DiagnosticManager: executable-path=./build/bin/diagnostic_manager, bootstrap=false, function-group-state{function-group=MachineFG, function-group-state=StartUp}
