AUTOSAR XML (schema 00050)
package /ExecutionManifest
  communication-cluster protocol-version=1:
    ethernet physical channel Localhost
      network endpoint RpcServerEP: network-endpoint-addresses=ipv-4-configuration=ipv-4-address=127.0.0.1
  ethernet communication connector RpcServerConn
    ap application endpoint ServerUnicastTcp: tp-configuration=tcp-tp=tcp-tp-port=port-number=18081
  function group MachineFG
    mode-declaration-group initial-mode=Off:
      mode Off
      mode StartUp
