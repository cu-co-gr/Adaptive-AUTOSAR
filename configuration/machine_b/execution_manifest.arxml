AUTOSAR XML (schema 00050)
package /ExecutionManifest
  communication-cluster protocol-version=1:
    ethernet physical channel Localhost
      network endpoint RpcServerEP: network-endpoint-addresses=ipv-4-configuration=ipv-4-address=127.0.0.1
  ethernet communication connector RpcServerConn
    ap application endpoint ServerUnicastTcp: tp-configuration=tcp-tp=tcp-tp-port=port-number=18081
  function group MachineFG
    mode-declaration-group initial-mode=Off:
      mode Off
      mode StartUp
  processes:
    6 x process:
      StateManagement: executable-path=./build/bin/state_management, bootstrap=true, process-arguments=./configuration/machine_b/execution_manifest.arxml
      PlatformHealthManagement: executable-path=./build/bin/platform_health_management, bootstrap=false, fifo-path=/tmp/fifo_18081, process-arguments=[./configuration/machine_b/execution_manifest.arxml, ./configuration/machine_b/health_monitoring_manifest.arxml], function-group-state{function-group=MachineFG, function-group-state=StartUp}
      DiagnosticManager: executable-path=./build/bin/diagnostic_manager, bootstrap=false, process-arguments=[./configuration/machine_b/execution_manifest.arxml, ./configuration/machine_b/diagnostic_manager_manifest.arxml], function-group-state{function-group=MachineFG, function-group-state=StartUp}
      WatchdogApplication: executable-path=./build/bin/watchdog_application, bootstrap=false, process-arguments=[./configuration/machine_b/execution_manifest.arxml, ./configuration/machine_b/watchdog_manifest.arxml], function-group-state{function-group=MachineFG, function-group-state=StartUp}
      UpdateConfigManager: executable-path=./build/bin/update_config_manager, bootstrap=false, process-arguments=[./configuration/machine_b/ucm_manifest.arxml, /tmp/ucm_b], function-group-state{function-group=MachineFG, function-group-state=StartUp}
      TimeSynchronization: executable-path=./build/bin/time_synchronization, bootstrap=false, function-group-state{function-group=MachineFG, function-group-state=StartUp}
