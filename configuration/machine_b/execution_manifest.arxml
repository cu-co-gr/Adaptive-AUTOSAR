AUTOSAR XML (schema 00050)
package /ExecutionManifest
  communication-cluster protocol-version=1:
    ethernet physical channel Localhost
      network endpoint RpcServerEP: network-endpoint-addresses=ipv-4-configuration=ipv-4-address=127.0.0.1
  ethernet communication connector RpcServerConn
    ap application endpoint ServerUnicastTcp: tp-configuration=tcp-tp=tcp-tp-port=port-number=18081
  function group MachineFG
    mode-declaration-group initial-mode=Off:
      mode Off
      mode StartUp
  processes:
    process StateManagement: executable-path=./build/bin/state_management, bootstrap=true, process-arguments=./configuration/machine_b/execution_manifest.arxml
    process WatchdogApplication: executable-path=./build/bin/watchdog_application, bootstrap=false, process-arguments=[./configuration/machine_b/execution_manifest.arxml, ./configuration/machine_b/watchdog_manifest.arxml], function-group-state{function-group=MachineFG, function-group-state=StartUp}
