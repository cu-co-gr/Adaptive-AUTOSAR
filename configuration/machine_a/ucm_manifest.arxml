AUTOSAR XML (schema 00050)
package /UcmManifest
  communication-cluster protocol-version=1:
    ethernet physical channel UcmLocalhost
      network endpoint UcmServerEP: network-endpoint-addresses=ipv-4-configuration=ipv-4-address=127.0.0.1
  ethernet communication connector UcmConnector
    ap application endpoint PackageManagementTcp: tp-configuration=tcp-tp=tcp-tp-port=port-number=8090
