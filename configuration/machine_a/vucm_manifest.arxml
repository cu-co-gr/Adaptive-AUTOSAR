AUTOSAR XML (schema 00050)
package /VucmManifest
  communication-cluster protocol-version=1:
    ethernet physical channel UcmBChannel
      network endpoint UcmBTargetEP: network-endpoint-addresses=ipv-4-configuration=ipv-4-address=192.168.2.96
  ethernet communication connector UcmBConnector
    ap application endpoint UcmBTcp: tp-configuration=tcp-tp=tcp-tp-port=port-number=8090
