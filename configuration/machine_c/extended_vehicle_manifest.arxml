AUTOSAR XML (schema 00050)
package /ExtendedVehicleManifest
  elements do-ip-instantiation={eid=1, gid=1, logical-address=1, network-interfaces=do-ip-network-configuration={max-initial-vehicle-announcement-time=0, vehicle-announcement-count=3, vehicle-announcement-interval=1}}, provided-someip-service-instance={service-interface-deployment={service-interface-id=5, service-interface-version={major-version=1, minor-version=0}}, someip-provided-event-group{event-group-id=1, event-multicast-udp-port=5555, ipv-4-multicast-ip-address=239.0.0.1}, sd-server-config={initial-offer-behavior={initial-delay-min-value=100, initial-delay-max-value=200}, unicast-peers=192.168.1.94}, service-instance-id=2}:
    communication-cluster:
      ethernet physical channel Localhost
        network endpoint ExtendedVehicleEP: network-endpoint-addresses=ipv-4-configuration=ipv-4-address=192.168.1.96
    ethernet communication connector ExtendedVehicleConn
      ap application endpoint ServerUnicastTcp: tp-configuration=tcp-tp=tcp-tp-port=port-number=8081
