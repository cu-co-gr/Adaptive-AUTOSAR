AUTOSAR XML (schema 00050)
package /ExecutionManifest
  communication-cluster protocol-version=1:
    ethernet physical channel Localhost
      network endpoint RpcServerEP: network-endpoint-addresses=ipv-4-configuration=ipv-4-address=127.0.0.1
  ethernet communication connector RpcServerConn
    ap application endpoint ServerUnicastTcp: tp-configuration=tcp-tp=tcp-tp-port=port-number=18080
  function group MachineFG
    mode-declaration-group initial-mode=Off:
      mode Off
      mode StartUp
  processes:
    5 x process:
      StateManagement: executable-path=./deploy/bin/state_management, bootstrap=true, process-arguments=./configuration/machine_d/execution_manifest.arxml
      PlatformHealthManagement: executable-path=./deploy/bin/platform_health_management, bootstrap=false, fifo-path=/tmp/fifo_18080, process-arguments=[./configuration/machine_d/execution_manifest.arxml, ./configuration/machine_d/health_monitoring_manifest.arxml], function-group-state{function-group=MachineFG, function-group-state=StartUp}
      ExtendedVehicle: executable-path=./deploy/bin/extended_vehicle, bootstrap=false, fifo-path=/tmp/fifo_18080, process-arguments=[./configuration/machine_d/execution_manifest.arxml, ./configuration/machine_d/extended_vehicle_manifest.arxml], function-group-state{function-group=MachineFG, function-group-state=StartUp}
      DiagnosticManager: executable-path=./deploy/bin/diagnostic_manager, bootstrap=false, process-arguments=[./configuration/machine_d/execution_manifest.arxml, ./configuration/machine_d/diagnostic_manager_manifest.arxml], function-group-state{function-group=MachineFG, function-group-state=StartUp}
      UpdateConfigManager: executable-path=./deploy/bin/update_config_manager, bootstrap=false, process-arguments=[./configuration/machine_d/ucm_manifest.arxml, /data/ucm_d], function-group-state{function-group=MachineFG, function-group-state=StartUp}
