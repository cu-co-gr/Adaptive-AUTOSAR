AUTOSAR XML (schema 00050)
package /UcmManifest
  communication-cluster protocol-version=1:
    ethernet physical channel UcmEthernet
      network endpoint UcmServerEP: network-endpoint-addresses=ipv-4-configuration=ipv-4-address=192.168.56.106
  ethernet communication connector UcmConnector
    ap application endpoint PackageManagementTcp: tp-configuration=tcp-tp=tcp-tp-port=port-number=8090
