AUTOSAR XML (schema 00050)
package /ExecutableDescription
  composition sw component type ApplicationComposition
    5 x component:
      ExtendedVehicleInstance: type=ExtendedVehicle
      WatchdogApplicationInstance: type=WatchdogApplication
      UpdateConfigManagerInstance: type=UpdateConfigurationManager
      VehicleUpdateConfigMgrInstance: type=VehicleUpdateConfigurationManager
      TimeSynchronizationInstance: type=TimeSynchronization
  5 x executable:
    ExtendedVehicle: root-sw-component-prototype=ExtendedVehicleInstance, scheduler-granularity=10
    WatchdogApplication: root-sw-component-prototype=WatchdogApplicationInstance, scheduler-granularity=10
    UpdateConfigurationManager: root-sw-component-prototype=UpdateConfigManagerInstance, scheduler-granularity=10
    VehicleUpdateConfigManager: root-sw-component-prototype=VehicleUpdateConfigMgrInstance, scheduler-granularity=10
    TimeSynchronization: root-sw-component-prototype=TimeSynchronizationInstance, scheduler-granularity=1000
  5 x process design, all with function-group-state{function-group=MachineFG, function-group-state=StartUp}:
    ExtendedVehicleProcess: executable=ExtendedVehicle
    WatchdogApplicationProcess: executable=WatchdogApplication
    UpdateConfigManagerProcess: executable=UpdateConfigurationManager
    VehicleUpdateConfigMgrProcess: executable=VehicleUpdateConfigManager
    TimeSynchronizationProcess: executable=TimeSynchronization
