AUTOSAR XML (schema 00050)
package /ExtendedVehicleServiceDesign
  impl type Vin17Type: category=STRING
  impl type VehicleStatusType: category=STRUCTURE
    element Vin: category=TYPE_REFERENCE, type=Vin17Type
    element ConnectedToCloud: category=VALUE
  service interface ExtendedVehicleInterface
    events:
      data TelematicControlModuleEvent: type=VehicleStatusType
  someip service interface deployment ExtendedVehicleInterfaceDeployment: service-interface=ExtendedVehicleInterface, service-interface-id=5, service-interface-version={major-version=1, minor-version=0}
    someip event deployment TelematicControlModuleEventDeployment: event=TelematicControlModuleEvent, event-id=32769
    event-group-deployments:
      someip event group VehicleEventsGroup: event-group-id=1, event=TelematicControlModuleEvent
