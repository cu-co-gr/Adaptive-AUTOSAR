AUTOSAR XML (schema 00050)
package /UcmSwInteractionDescription
  someip service interface deployment VucmToUcmAConnector: note=VUCM (Machine A) calls UCM_A on 127.0.0.1:8090 via PackageManagement RPC. Phase 1: TransferStart.name = absolute path to .swpkg file on shared FS. TransferData blocks are empty (size=0). UCM_A verifies file at path on TransferExit.
  someip service interface deployment VucmToUcmBConnector: note=VUCM (Machine A) calls UCM_B on 127.0.0.1:8091 (Phase 1) or 192.168.2.96:8090 (Phase 2 — UNOQ) via PackageManagement RPC. Phase 1 end-to-end: UCM_B on port 8091; VUCM drives the full TransferStart → TransferData → TransferExit → ProcessSwPackage → Activate sequence.
  4 x note element:
    UcmToRegistryAndEm: note=UCM Activate logic: 1. Extract .swpkg.tar.gz → FileStorage staging dir. 2. Copy binary to installRoot/bin/. 3. Parse manifest/process_entry.xml via pugixml; append PROCESS node to configuration/machine_*/execution_manifest.arxml. 4. Update ucm_registry KeyValueStorage (SetValue(name, version)). 5. Log "[UCM] Activation complete — restart EM to apply". EM reads updated manifest via arxml::ArxmlReader on next startup (arxml::ArxmlReader IS the Registry ManifestAccessor — no daemon needed).
    UcmToAraPer: note=UCM uses two ara::per storage objects (native API, not ara::com port): - FileStorage at /var/per/ucm_packages/ (fallback /tmp/per/ucm_packages/): WriteFile / ReadFile / DeleteFile for SW Package binary data. Atomic writes (tmp + rename) prevent partial-package corruption. - KeyValueStorage at /var/per/ucm_registry.json (fallback /tmp/per/): SetValue(name, version) on Activate; GetAllKeys() for GetSwClusterInfo(). SyncToStorage() called after each successful Activate.
    UcmToAraLog: note=UCM and VUCM log via ara::log::LogStream (native API). Log prefixes: "[UCM] ..." and "[VUCM] ..." for easy grepping in run_demo.sh output.
    UcmToAraExec: note=UCM and VUCM are ModelledProcess subclasses: - Constructor: sets up PackageManagementSkeleton / PackageManagementProxy. - Main(): enters WaitForActivation() loop. - Destructor: cleans up proxy/skeleton. No PHM supervised entity needed for UCM/VUCM in this educational deployment.
