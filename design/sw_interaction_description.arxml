AUTOSAR XML (schema 00050)
package /SwInteractionDescription
  sw connector VehicleServiceSdConnector: kind=SERVICE-DISCOVERY, transport=SOME-IP-SD-UDP-MULTICAST, provider={process-design=AdaptiveAutosarProcess, port-prototype=AdaptiveAutosarRoot / ExtendedVehicleInstance / VehicleServicePPort}, requirer={process=AdaptiveAutosarProcess (remote machine), manifest=diagnostic_manager_manifest.arxml, element=REQUIRED-SOMEIP-SERVICE-INSTANCE}
  sw connector VehicleServiceDoipConnector: kind=DIAGNOSTIC-TRANSPORT, transport=DOIP-TCP-UNICAST, provider={process-design=AdaptiveAutosarProcess, port-prototype=AdaptiveAutosarRoot / ExtendedVehicleInstance / VehicleServicePPort}, requirer={process=AdaptiveAutosarProcess (remote machine), manifest=diagnostic_manager_manifest.arxml, element=OBD-TO-DOIP converter (post SD discovery)}
  sw connector VehicleServiceEventConnector: kind=EVENT-NOTIFICATION, transport=SOME-IP-PUBSUB-UDP-MULTICAST, status=PLANNED — NOT YET IMPLEMENTED, provider={process-design=AdaptiveAutosarProcess, port-prototype=AdaptiveAutosarRoot / ExtendedVehicleInstance / VehicleServicePPort, event=TelematicControlModuleEvent, event-group-id=1}, requirer={process=AdaptiveAutosarProcess (remote machine), manifest=diagnostic_manager_manifest.arxml}
  fc port interaction PhysicalHealthManagementBinding: port-prototype=AdaptiveAutosarRoot / ExtendedVehicleInstance / HealthManagementRPort, fc-endpoint=PlatformHealthManagement::FifoCheckpointCommunicator, instance-specifier=ExtendedVehicleSE, transport=POSIX-NAMED-PIPE, pipe-path=/tmp/fifo_<rpcPort>, configuration=health_monitoring_manifest.arxml
  sw connector WatchdogSdConnector: kind=SERVICE-DISCOVERY, status=PLANNED, transport=SOME-IP-SD-UDP-MULTICAST, requirer={process-design=AdaptiveAutosarProcess, port-prototype=AdaptiveAutosarRoot / WatchdogInstance / VehicleServiceRPort}, provider={process=AdaptiveAutosarProcess (remote machine), manifest=extended_vehicle_manifest.arxml (remote machine), element=PROVIDED-SOMEIP-SERVICE-INSTANCE, Instance ID 1 or 0}
  sw connector WatchdogSubscriptionConnector:
    kind=EVENT-SUBSCRIPTION
    status=PLANNED — subscription handshake wired on server side, client side not yet instantiated
    transport=SOME-IP-SD-UDP-MULTICAST
    requirer={process-design=AdaptiveAutosarProcess, port-prototype=AdaptiveAutosarRoot / WatchdogInstance / VehicleServiceRPort, event-group-id=1}
    provider={process=AdaptiveAutosarProcess (remote machine), element=PROVIDED-EVENT-GROUPS / SOMEIP-PROVIDED-EVENT-GROUP (extended_vehicle_manifest.arxml remote machine)}
  sw connector WatchdogHeartbeatConnector:
    kind=EVENT-NOTIFICATION
    status=PLANNED — blocked on SomeIpPubSubServer::Publish() and SOME/IP event frame decoder
    transport=SOME-IP-PUBSUB-UDP-MULTICAST
    requirer={process-design=AdaptiveAutosarProcess, port-prototype=AdaptiveAutosarRoot / WatchdogInstance / VehicleServiceRPort, event=TelematicControlModuleEvent, event-group-id=1}
    provider={process=AdaptiveAutosarProcess (remote machine), element=ExtendedVehicleInstance / VehicleServicePPort / TelematicControlModuleEvent}
  sw to diagnostics interaction TelematicModuleDtcMapping: dtc-number=49560, trigger=SD state of service 5 / VehicleServicePPort (planned: TelematicControlModuleEvent receipt timeout), monitor-instance-specifier=TelematicControlModuleMonitor, event-instance-specifier=TelematicControlModuleEvent, process-design=AdaptiveAutosarProcess, configuration=diagnostic_manager_manifest.arxml
