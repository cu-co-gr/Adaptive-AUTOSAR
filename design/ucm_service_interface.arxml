AUTOSAR XML (schema 00050)
package /UcmServiceInterface
  4 x impl type:
    TransferIdType: category=VALUE, base-type=uint32
    ByteVectorType: category=ARRAY, element={category=VALUE, base-type=uint8}
    PackageInfoType: category=STRUCTURE
      element name: category=VALUE, base-type=string
      element version: category=VALUE, base-type=string
      element size: category=VALUE, base-type=uint64
    UpdateStateType: category=VALUE, data-constr={constr-level=0, internal-constrs={lower-limit=0, upper-limit=6}}, base-type=uint8
  service interface PackageManagement: category=SOMEIP
    methods:
      7 x operation:
        TransferStart
          arg info: direction=IN, type=PackageInfoType
          arg transferId: direction=OUT, type=TransferIdType
        TransferData
          arg transferId: direction=IN, type=TransferIdType
          arg block: direction=IN, type=ByteVectorType
          arg blockCounter: direction=IN, base-type=uint32
        TransferExit
          arg transferId: direction=IN, type=TransferIdType
        ProcessSwPackage
          arg transferId: direction=IN, type=TransferIdType
        Activate
          arg installRoot: direction=IN, base-type=string
          arg executionManifestPath: direction=IN, base-type=string
        GetSwClusterInfo
          arg clusters: direction=OUT, type=PackageInfoType
        GetCurrentStatus
          arg state: direction=OUT, type=UpdateStateType
  someip service interface deployment PackageManagementDeployment: service-interface=PackageManagement, service-interface-id=192, service-interface-version={major-version=1, minor-version=0}, default-tcp-port=8090
    7 x someip method deployment:
      TransferStart: method-id=1
      TransferData: method-id=2
      TransferExit: method-id=3
      ProcessSwPackage: method-id=4
      Activate: method-id=5
      GetSwClusterInfo: method-id=6
      GetCurrentStatus: method-id=7
